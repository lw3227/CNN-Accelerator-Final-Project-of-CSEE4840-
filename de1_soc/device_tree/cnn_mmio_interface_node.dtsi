/*
 * Child node for the current de1_soc Platform Designer system.
 *
 * Parent bus: bridge@0xc0000000
 *   compatible = "altr,bridge-21.1", "simple-bus"
 *   reg-names = "axi_h2f", "axi_h2f_lw"
 *
 * The lw bridge window is exposed through ranges:
 *   <0x1 0x0 0xff200000 0x8>
 *
 * Existing child nodes under that bus therefore use a 2-cell child address
 * where <0x1 0x0> maps to HPS-visible base 0xff200000.
 */

cnn_mmio_interface@0x100000000 {
	compatible = "csee4840,cnn-mmio-interface";
	reg = <0x1 0x0 0x00200000>;
	label = "cnn_mmio_interface";
	status = "okay";
};
